AUTOSAR XML (schema 00049)
package /MICROSAR/ADAPTIVE
  sdg def SomeIpTpBurstSizeExtension
    sdg-classes:
      sdg class SomeipMethodDeploymentBurstSizeExtension: extends-meta-class=SomeipMethodDeployment
        sdg primitive attribute burstSizeRequest: category=INTEGER, lower-multiplicity=0, upper-multiplicity=1, max=4294967295, min=1  # Specifies the number of segments for the Method Call that shall be transmitted in a burst ignoring separation Time. SeparationTime will then only be applied between bursts. If not configured, SeparationTime will be applied between all frames.
        sdg primitive attribute burstSizeResponse: category=INTEGER, lower-multiplicity=0, upper-multiplicity=1, max=4294967295, min=1  # Specifies the number of segments for the Method Response that shall be transmitted in a burst ignoring separationTime. SeparationTime will then only be applied between bursts. If not configured, SeparationTime will be applied between all frames.
      sdg class SomeipEventDeploymentBurstSizeExtension: extends-meta-class=SomeipEventDeployment
        sdg primitive attribute burstSize: category=INTEGER, lower-multiplicity=0, upper-multiplicity=1, max=4294967295, min=1  # Specifies the number of segments that shall be transmitted in a burst ignoring separationTime. SeparationTime will then only be applied between bursts. If not configured, SeparationTime will be applied between all frames.
