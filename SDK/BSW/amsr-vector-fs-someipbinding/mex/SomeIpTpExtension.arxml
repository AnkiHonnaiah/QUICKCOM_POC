AUTOSAR XML (schema 00049)
package /MICROSAR/ADAPTIVE
  sdg def SomeIpTpExtension
    sdg-classes:
      sdg class SomeipMethodDeploymentTpExtension: extends-meta-class=SomeipMethodDeployment
        sdg primitive attribute preallocatedRxBufferCount: category=INTEGER, lower-multiplicity=0, upper-multiplicity=1, max=4294967295, min=1  # Specifies the number of rx buffers that shall be pre-allocated for receiving SOME/IP-TP messages. If not configured, dynamic allocation will be applied.
      sdg class SomeipEventDeploymentTpExtension: extends-meta-class=SomeipEventDeployment
        sdg primitive attribute preallocatedRxBufferCount: category=INTEGER, lower-multiplicity=0, upper-multiplicity=1, max=4294967295, min=1  # Specifies the number of rx buffers that shall be pre-allocated for receiving SOME/IP-TP messages. If not configured, dynamic allocation will be applied.
