AUTOSAR XML (schema 00049)
package /MICROSAR/ADAPTIVE
  sdg def TlsSecureComPropsExtension
    sdg-classes:
      sdg class TlsSecureComPropsExtension: extends-meta-class=TlsSecureComProps
        sdg primitive attribute dtlsCookieVerificationEnabled: category=BOOLEAN, lower-multiplicity=0, upper-multiplicity=1  # If true, enables DTLS cookie verification for UDP secure endpoints. If it is not configured, its default value is false. If it is configured in one UDP endpoint, it must be configured with the same value in all UDP endpoints.
