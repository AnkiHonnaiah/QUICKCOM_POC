AUTOSAR XML (schema 00049)
package /MICROSAR/ADAPTIVE
  sdg def NetworkEndpointModelExtension
    sdg-classes:
      sdg class NetworkEndpointModelExtension: extends-meta-class=NetworkEndpoint
        5 x sdg primitive attribute, all with category=INTEGER, lower-multiplicity=0, upper-multiplicity=1:
          bulkReadReceivePeriodUs: max=4294967295, min=0  # This optional attribute allows configuring a polling period (in microseconds) for polling-based packet reception.
          bulkReadMaxNoOfConsecutiveReceiveCalls: max=65535, min=1  # This optional attribute allows configuring a maximum number of consecutive receive calls within one polling iteration.
          bulkReadMinNoOfDatagramsForConsecutiveReceiveCalls: max=65535, min=1  # This optional attribute allows configuring a minimum number of datagrams to obtain from a single receive call. If fewer datagrams are obtained than defined in this threshold, no further receive calls are performed within the same polling iteration.
          noOfInvalidTcpMessagesBeforeDisconnection: max=65535, min=0  # This optional attribute allows configuring a threshold for the number of invalid messages before closing the TCP connection.
          noOfConsecutiveValidTcpMessagesBeforeErrorReset: max=65535, min=0  # This optional attribute allows configuring a threshold for the number of consecutive valid messages received before the error counter (NoOfInvalidTcpMessagesBeforeDisconnection) is reset.
