AUTOSAR XML (schema 00049)
package /MICROSAR/ADAPTIVE
  sdg def IpcEndpointExtensionModel
    sdg-classes:
      sdg class IpcEndpointExtension: extends-meta-class=SoftwareCluster
        attributes:
          sdg aggregation with variation ipcEndpointRef: lower-multiplicity=0, upper-multiplicity-infinite=true, sub-sdg=IpcEndpoint
      sdg class IpcEndpoint: caption=true
        sdg primitive attribute addressPort: category=INTEGER, lower-multiplicity=1, upper-multiplicity=1, max=4294967295, min=1  # This attribute represents the SomeIpDaemon Address Port which is used for the communication between the application and the SomeIpDaemon.
