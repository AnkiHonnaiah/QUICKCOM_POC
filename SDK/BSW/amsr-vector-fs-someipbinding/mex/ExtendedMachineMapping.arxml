AUTOSAR XML (schema 00049)
package /MICROSAR/ADAPTIVE
  sdg def EventGroupEntryEndpointOptionExtension
    sdg-classes:
      sdg class EventGroupEntryEndpointOptionType
        sdg primitive attribute ipV4Address: category=STRING, lower-multiplicity=0, upper-multiplicity=1  # An IPv4 Address (string representation).
        sdg primitive attribute ipV6Address: category=STRING, lower-multiplicity=0, upper-multiplicity=1  # An IPv6 Address (string representation).
        sdg primitive attribute port: category=INTEGER, lower-multiplicity=0, upper-multiplicity=1  # A port.
      sdg class EventGroupEntryEndpointOption: extends-meta-class=SomeipServiceInstanceToMachineMapping
        attributes:
          sdg aggregation with variation tcpEndpointOption: lower-multiplicity=0, upper-multiplicity=1, sub-sdg=EventGroupEntryEndpointOptionType  # An optional TCP endpoint. If configured, it will be used as endpoint option in the subscribe eventgroup message.
          sdg aggregation with variation udpEndpointOption: lower-multiplicity=0, upper-multiplicity=1, sub-sdg=EventGroupEntryEndpointOptionType  # An optional UDP endpoint. If configured, it will be used as endpoint option in the subscribe eventgroup message.
