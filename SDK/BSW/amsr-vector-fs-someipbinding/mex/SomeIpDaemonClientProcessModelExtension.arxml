AUTOSAR XML (schema 00049)
package /MICROSAR/ADAPTIVE
  sdg def SomeIpDaemonClientModelExtension
    sdg-classes:
      sdg class SomeIpDaemonClientProcessModelExtension: extends-meta-class=Process
        attributes:
          4 x sdg primitive attribute, all with lower-multiplicity=0, upper-multiplicity=1:
            defaultIpcPort: category=INTEGER, max=4294967295, min=1  # This optional attribute represents the default SomeIpDaemon Address Port which is used for the communication between a service instance of this application process and the SomeIpDaemon in case no IpcEndpoint is mapped to this ServiceInstance.
            ipcMaximumQueueSize: category=INTEGER, max=4294967295, min=0  # This optional attribute represents the IPC Maximum Queue Size. The queue size is unlimited when the IPC Maximum Queue Size is not set or is set to 0. In case the amount of messages exceeds the maximum size of the queue, an error will be logged and the oldest message in the transmission queue will be dropped before a new message gets enqueued.
            someipDaemonConnectionRetrialEnabled: category=BOOLEAN  # This optional attribute is used for enabling connection retrial during initialization with the SomeIpDaemon. This feature allows starting the SomeIpDaemon and the application in any order. Default: disabled
            someipDaemonConnectionRetrialIntervalMs: category=INTEGER, max=4294967295, min=0  # This optional attribute represents the interval for the connection retrial with the SomeIpDaemon in milliseconds. Default: 1000
          sdg reference ipcEndpoint: lower-multiplicity=0, upper-multiplicity=1, dest-sdg=IpcEndpoint  # This optional attribute represents a reference to an IPC endpoint.
