AUTOSAR XML (schema 00049)
package /MICROSAR/ADAPTIVE
  sdg def Mex4MixedSd
    sdg-classes:
      6 x sdg class:
        MixedSdSomeipServiceInstanceToMachineMapping: extends-meta-class=SomeipServiceInstanceToMachineMapping
          attributes:
            sdg aggregation with variation staticServiceDiscovery: lower-multiplicity=0, upper-multiplicity=1, sub-sdg=StaticServiceDiscovery  # This optional attribute is used for disabling Service Discovery as defined by the AUTOSAR Service Discovery protocol. It allows manual and static configuration of the addresses where service providers and event consumers can be found.
        StaticServiceDiscovery
          attributes:
            sdg aggregation with variation serviceProvider: lower-multiplicity=0, upper-multiplicity=1, sub-sdg=ServiceProvider  # This optional attribute represents the IP address where a provided service can be found.
            sdg aggregation with variation eventSubscribers: lower-multiplicity=0, upper-multiplicity=1, sub-sdg=EventSubscribers  # This optional attribute represents a container of static subscribers to a provided eventgroup.
        EventSubscribers
          attributes:
            sdg aggregation with variation subscriber: lower-multiplicity=0, upper-multiplicity-infinite=true, sub-sdg=Subscriber  # This optional attribute represents a list of eventgroup subscribers.
        Subscriber
          attributes:
            sdg primitive attribute ipAddress: category=STRING, lower-multiplicity=1, upper-multiplicity=1  # This attribute represents the IP Address of an event consumer.
            sdg primitive attribute udpPort: category=INTEGER, lower-multiplicity=0, upper-multiplicity=1  # This attribute represents the port of an event consumer.
            sdg aggregation with variation eventgroups: lower-multiplicity=0, upper-multiplicity-infinite=true, sub-sdg=EventGroup  # This optional attribute represents a list of eventgroups to which a subscriber is statically subscribed to.
        EventGroup
          sdg primitive attribute eventgroup: category=INTEGER, lower-multiplicity=1, upper-multiplicity=1  # This attribute represents the ID of an eventgroup.
        ServiceProvider
          5 x sdg primitive attribute, all with upper-multiplicity=1:
            ipAddress: category=STRING, lower-multiplicity=1  # This attribute provides the ipAddress of the ServiceProvider.
            tcpPort: category=INTEGER, lower-multiplicity=0  # This optional attribute represents the tcpPort of the ServiceProvider.
            udpPort: category=INTEGER, lower-multiplicity=0  # This optional attribute represents the udpPort of the ServiceProvider.
            multicastAddress: category=STRING, lower-multiplicity=0  # This optional attribute represents the multicastAddress of the ServiceProvider.
            multicastPort: category=INTEGER, lower-multiplicity=0  # This optional attribute represents the multicastPort of the ServiceProvider.
