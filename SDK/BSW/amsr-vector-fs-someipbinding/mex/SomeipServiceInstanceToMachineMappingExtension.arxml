AUTOSAR XML (schema 00049)
package /MICROSAR/ADAPTIVE
  sdg def SomeipServiceInstanceToMachineMappingModelExtension
    sdg-classes:
      sdg class SomeipServiceInstanceToMachineMappingModelExtension: extends-meta-class=SomeipServiceInstanceToMachineMapping
        attributes:
          10 x sdg primitive attribute, all with lower-multiplicity=0, upper-multiplicity=1:
            tcpNaglesAlgorithm: category=BOOLEAN  # This optional attribute used to enable/ disable the nagles algorithm for the Service Instance that is using a TCP network connection. E.g with True, Nagle's Algorithm is enabled.
            enableSocketLinger: category=BOOLEAN  # This optional attribute is used to enable/ disable the socket option lingering for the Service Instance that is using a TCP network connection. E.g with true, socket lingering is enabled, the default is disabled.
            tcpKeepAlives: category=BOOLEAN  # This optional attribute indicates if Keep-Alive messages are sent.
            tcpKeepAliveInterval: category=INTEGER, max=4294967295, min=1  # If Keep-Alive messages are sent, this attribute specifies the interval in seconds between subsequent keepalive probes.
            tcpKeepAliveProbesMax: category=INTEGER, max=4294967295, min=1  # If Keep-Alive messages are sent, this attribute specifies the maximum number of times that TCP retransmits an individual data segment before aborting the connection.
            tcpKeepAliveTime: category=INTEGER  # If Keep-Alive messages are sent, this attribute specifies the time in seconds between the last data packet sent and the first keepalive probe.
            vlanPriority: category=INTEGER, max=7, min=0  # This optional attribute specifies the QoS VLAN priority of messages sent over the socket used by the Service Instance.
            bulkReadReceivePeriodUs: category=INTEGER, max=4294967295, min=0  # This optional attribute allows configuring a polling period (in microseconds) for polling-based packet reception.
            noOfInvalidTcpMessagesBeforeDisconnection: category=INTEGER, max=65535, min=0  # This optional attribute allows configuring a threshold for the number of invalid messages before closing the TCP connection.
            noOfConsecutiveValidTcpMessagesBeforeErrorReset: category=INTEGER, max=65535, min=0  # This optional attribute allows configuring a threshold for the number of consecutive valid messages received before the error counter (NoOfInvalidTcpMessagesBeforeDisconnection) is reset.
          sdg reference ipcEndpoint: lower-multiplicity=0, upper-multiplicity=1, dest-sdg=IpcEndpoint  # This optional attribute represents a reference to an IPC endpoint.
