AUTOSAR XML (schema 00049)
package /MICROSAR/ADAPTIVE
  sdg def Mex4SignalToService
    sdg-classes:
      5 x sdg class:
        Mex4SomeipEventDeployment: extends-meta-class=SomeipEventDeployment
          attributes:
            sdg aggregation with variation machineSubscribers: lower-multiplicity=0, upper-multiplicity-infinite=true, sub-sdg=MachineSubscriber  # This optional attribute represents different endpoints are providing the service
            sdg aggregation with variation pduHeaderExtensionTx: lower-multiplicity=0, upper-multiplicity=1, sub-sdg=PduHeaderExtensionFieldsTx  # This optional attribute provides fields for the PDU header extension. If enabled all fields must be set.
            sdg primitive attribute hasPduHeaderExtensionRx: category=BOOLEAN, lower-multiplicity=0, upper-multiplicity=1  # This optional attribute specifies a flag to indicate if the PDU header extension shall be considered during reception. The flag is automatically set to true if pduHeaderExtensionTx is enabled.
            sdg primitive attribute mappingMultiplePdusIsAllowed: category=BOOLEAN, lower-multiplicity=0, upper-multiplicity=1  # This optional attribute represents mapping of PduIds to one event. E.g With True, mapping Mutliple PduIds are enabled.
            sdg primitive attribute requiredPduIdRemapping: category=INTEGER, lower-multiplicity=0, upper-multiplicity-infinite=true  # This optional attribute represents a list of PDUIds should be added for the EventDeployment corresponding to the burst.
        MachineSubscriber
          attributes:
            sdg aggregation with variation subscribers: lower-multiplicity=0, upper-multiplicity-infinite=true, sub-sdg=Subscriber  # This optional attribute represent different endpoints that are subscribing to the service
            sdg foreign reference serviceInstanceToMachineMappingRef: lower-multiplicity=0, upper-multiplicity=1, dest-meta-class=ServiceInstanceToMachineMapping  # This optional attribute represents the SomeipServiceInstanceToMachineMapping Autosar Object
        Subscriber
          attributes:
            sdg primitive attribute ipAddress: category=STRING, lower-multiplicity=0, upper-multiplicity=1  # This attribute provides the ipAddress of the Subscriber.
            sdg primitive attribute port: category=INTEGER, lower-multiplicity=0, upper-multiplicity=1  # This attribute provides the port of the Subscriber.
            sdg primitive attribute pduId: category=INTEGER, lower-multiplicity=0, upper-multiplicity=1  # This optional attribute provides the Provided PDU Remapping.
            sdg foreign reference eventGroupRef: lower-multiplicity=0, upper-multiplicity=1, dest-meta-class=SomeipEventGroup  # This optional attribute represents the Event Group Object.
        Mex4SomeipServiceInstanceToMachineMapping: extends-meta-class=SomeipServiceInstanceToMachineMapping
        PduHeaderExtensionFieldsTx
          6 x sdg primitive attribute, all with category=INTEGER, lower-multiplicity=1, upper-multiplicity=1:
            clientId  # This attribute provides the client id for the PDU header extension.
            sessionId  # This attribute provides the session id for the PDU header extension.
            protocolVersion  # This attribute provides the protocol version for the PDU header extension.
            interfaceVersion  # This attribute provides the interface version for the PDU header extension.
            messageType  # This attribute provides the message type for the PDU header extension.
            returnCode  # This attribute provides the return code for the PDU header extension.
