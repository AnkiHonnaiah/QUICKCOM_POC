AUTOSAR XML (schema 00049)
package /MICROSAR/ADAPTIVE
  sdg def TlsCryptoCipherSuiteExtension
    sdg-classes:
      sdg class TlsCryptoCipherSuiteExtension: extends-meta-class=TlsCryptoCipherSuite
        sdg primitive attribute cipherSuiteId: category=INTEGER, lower-multiplicity=0, upper-multiplicity=1  # Name of the CipherSuite according to the IANA assignments list.
        sdg primitive attribute pskUuid: category=STRING, lower-multiplicity=0, upper-multiplicity=1  # Logical key slot UUID for the PSK to be used. This will be provided to the conﬁgured trustzone crypto provider when the respective key is required.
