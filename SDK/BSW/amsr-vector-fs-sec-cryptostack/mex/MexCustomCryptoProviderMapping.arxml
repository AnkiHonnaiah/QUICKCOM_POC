AUTOSAR XML (schema 00049)
package /MICROSAR/ADAPTIVE
  sdg def CryptoExtensionModel
    sdg-classes:
      sdg class CryptoModuleInstantiationExtension: extends-meta-class=GenericModuleInstantiation
        attributes:
          sdg aggregation with variation customCryptoProviderMapping: category=false, lower-multiplicity=0, upper-multiplicity=255, sub-sdg=CryptoProviderNameToUuidMapping  # This attribute allows to directly define the mapping of a CryptoProvider name to an UUID
      sdg class CryptoProviderNameToUuidMapping
        sdg primitive attribute cryptoProviderName: category=STRING, lower-multiplicity=1, upper-multiplicity=1  # This is the name of CryptoProvider
        sdg primitive attribute uuid: category=STRING, lower-multiplicity=1, upper-multiplicity=1  # This attribute used to identify crypto provider with the name specified in cryptoProviderName
        sdg primitive attribute providerNamespace: category=STRING, lower-multiplicity=0, upper-multiplicity=1  # This is the namespace of CryptoProvider. Defaults to the name of the cryptoprovider.
