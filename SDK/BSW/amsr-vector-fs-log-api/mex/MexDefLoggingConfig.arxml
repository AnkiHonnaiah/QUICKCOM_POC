AUTOSAR XML (schema 00049)
package /MICROSAR/ADAPTIVE
  sdg def LogApiExtensionModel
    sdg-classes:
      6 x sdg class:
        LogTraceProcessExtensions: extends-meta-class=Process  # Provides additional options to customize logging behavior.
          9 x sdg primitive attribute, all with lower-multiplicity=0:
            maxQueueSize: category=INTEGER, upper-multiplicity=1, min=1  # The size of the internal buffer for log messages to be used in remote logging.
            configDirPath: category=STRING, upper-multiplicity=1, min-length=1  # The path to the configuration file (logging_config.json). Currently not required and not used by the logging framework.
            maxNumberOfLogSinks: category=INTEGER, upper-multiplicity=1, min=1  # The maximum number of active log sinks. Currently not required and not used by the logging framework.
            maxSupportedLogLevel: category=ENUMERATION, upper-multiplicity=1  # Log level threshold, messages sent with this or a higher severity level will be processed by the logging framework. Currently not required and not used by the logging framework.
            enableLogMode: category=ENUMERATION, upper-multiplicity=5  # The output sinks used for sending log messages. Use this attribute if Syslog is required. If not, LogTraceLogMode should be used instead.
            ipcPort: category=INTEGER, upper-multiplicity=1, max=65535, min=1  # IPC port number for communication with the LogDaemon. For details refer to TechnicalReference_LogAndTrace.
            maxLoggers: category=INTEGER, upper-multiplicity=1, min=1  # The size of the internal buffer for control messages used in remote logging. For details refer to TechnicalReference_LogAndTrace.
            enableLogConfigRequests: category=BOOLEAN, upper-multiplicity=1  # Enable commands to be received from LogDaemon. Origin can be LogConfig or DLT client. For details refer to TechnicalReference_LogAndTrace. Requires ipcPort to be set if enabled.
            timestampClock: category=ENUMERATION, upper-multiplicity=1  # Configures the type of clock which produces the timestamp used in log messages sent to Console, File and Custom sinks. Overrides timestampClock attribute set in LogAndTraceInstantiationClockExtensions for this process.
        ContextLogConfig  # Used to override the log level of DltLogChannels, and provide configuration for flushing the log stream.
          attributes:
            sdg reference sinkConfig: lower-multiplicity=1, upper-multiplicity=1, dest-sdg=LogSinkConfig  # Reference to a LogSinkConfig to be used.
            sdg primitive attribute level: category=ENUMERATION, lower-multiplicity=1, upper-multiplicity=1  # Specifies the log level for the configured context. Overrides logTraceDefaultLogLevel.
        LogSinkConfig: caption=true  # Used to configure log sinks for DLT channels application wide.
          5 x sdg primitive attribute, all with upper-multiplicity=1:
            mode: category=ENUMERATION, lower-multiplicity=1  # Specifies the logging mode to be configured.
            level: category=ENUMERATION, lower-multiplicity=1  # Specifies the log level to be configured.
            flushPeriod: category=INTEGER, lower-multiplicity=0  # Sets the interval in milliseconds to periodically flush messages from the buffer of the corresponding sink. Periodical flush is disabled if set to zero, or if logTraceDefaultLogLevel is below the flushThreshold. Note: Flush is only used for LogModes: kConsole and kFile.
            flushThreshold: category=ENUMERATION, lower-multiplicity=0  # Log messages below this threshold are flushed immediately. Note: Flush is only used for LogModes: kConsole and kFile.
            reconnectionRetryOffset: category=INTEGER, lower-multiplicity=0  # Currently not required and not used by the logging framework.
        LogTraceDltLogChannelExtensions: extends-meta-class=DltLogChannel  # Allows for configuration of sinks for a DltLogChannel.
          attributes:
            sdg aggregation with variation contextLogConfig: lower-multiplicity=0, upper-multiplicity=4, sub-sdg=ContextLogConfig  # Reference to a contextLogConfig.
        LogAndTraceInstantiationSinkExtensions: extends-meta-class=LogAndTraceInstantiation  # Provides the option to define logSinkConfigs.
          attributes:
            sdg aggregation with variation logSinkConfig: lower-multiplicity=0, upper-multiplicity=4, sub-sdg=LogSinkConfig  # Reference to a logSinkConfig.
        LogAndTraceInstantiationClockExtensions: extends-meta-class=LogAndTraceInstantiation  # Provides the option to define machine wide logging configuration attributes.
          sdg primitive attribute timestampClock: category=ENUMERATION, lower-multiplicity=0, upper-multiplicity=1  # Configures the type of clock which produces the timestamp used in log messages sent to Console, File and Custom sinks. Can be overridden per process by defining a the timestampClock attribute in LogTraceProcessExtensions.
