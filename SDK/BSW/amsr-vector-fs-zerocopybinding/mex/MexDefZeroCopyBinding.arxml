AUTOSAR XML (schema 00049)
package /MICROSAR/ADAPTIVE
  sdg def UserDefinedZeroCopyBindingExtensionModel
    sdg-classes:
      13 x sdg class:
        ProvidedZeroCopyBindingServiceInstanceExtension: extends-meta-class=ProvidedUserDefinedServiceInstance
          attributes:
            sdg aggregation with variation userDefinedZeroCopyBinding: lower-multiplicity=0, upper-multiplicity=1, variation=false, sub-sdg=ProvidedZeroCopyBindingServiceInstance
        ProvidedZeroCopyBindingServiceInstance  # Stores the zero copy binding data of the ProvidedUserDefinedServiceInstance.
          attributes:
            sdg primitive attribute serviceInstanceId: category=INTEGER, lower-multiplicity=1, upper-multiplicity=1, max=0xFFFFFFFE, min=0x0  # The service instance ID (32 bit unsigned integer).
            sdg aggregation with variation connectionEndpoint: lower-multiplicity=1, upper-multiplicity=1, variation=false, sub-sdg=ProvidedServiceInstanceConnectionEndpoint  # The connection endpoint of this service instance.
            sdg aggregation with variation eventInstance: lower-multiplicity=0, upper-multiplicity-infinite=true, variation=false, sub-sdg=ProvidedEventInstance  # Stores the configuration of all events of the ProvidedZeroCopyBindingServiceInstance.
        RequiredZeroCopyBindingServiceInstanceExtension: extends-meta-class=RequiredUserDefinedServiceInstance
          attributes:
            sdg aggregation with variation userDefinedZeroCopyBinding: lower-multiplicity=0, upper-multiplicity=1, variation=false, sub-sdg=RequiredZeroCopyBindingServiceInstance
        RequiredZeroCopyBindingServiceInstance  # Stores the zero copy binding data of the RequiredUserDefinedServiceInstance.
          attributes:
            sdg primitive attribute serviceInstanceId: category=STRING, lower-multiplicity=1, upper-multiplicity=1, pattern=0|[1-9][0-9]*|ALL  # The service instance ID (32 bit unsigned integer as string or 'ALL').
            sdg primitive attribute expectedMinimumServerIntegrityLevel: category=ENUMERATION, lower-multiplicity=0, upper-multiplicity=1  # The expected minimum integrity level of the server (QM, ASIL_A, ASIL_B, ASIL_C or ASIL_D). Default: QM.
            sdg aggregation with variation eventInstance: lower-multiplicity=0, upper-multiplicity-infinite=true, variation=false, sub-sdg=RequiredEventInstance  # Stores the configuration of all events of the RequiredZeroCopyBindingServiceInstance.
        ProvidedEventInstance  # Stores the configuration of a single event instance.
          attributes:
            sdg reference event: lower-multiplicity=1, upper-multiplicity=1, dest-sdg=ZeroCopyBindingEventDeployment  # The event this configuration refers to.
            sdg primitive attribute initialization: category=ENUMERATION, lower-multiplicity=1, upper-multiplicity=1  # The type of initialization for this event when providing a pointer to the shared memory area to the sender.
            6 x sdg aggregation with variation, all with lower-multiplicity=0, upper-multiplicity=1, variation=false:
              qmLimits: sub-sdg=ProvidedEventInstanceResourceLimit  # The resource limits of this event valid for QM receivers.
              asilALimits: sub-sdg=ProvidedEventInstanceResourceLimit  # The resource limits of this event valid for ASIL A receivers.
              asilBLimits: sub-sdg=ProvidedEventInstanceResourceLimit  # The resource limits of this event valid for ASIL B receivers.
              asilCLimits: sub-sdg=ProvidedEventInstanceResourceLimit  # The resource limits of this event valid for ASIL C receivers.
              asilDLimits: sub-sdg=ProvidedEventInstanceResourceLimit  # The resource limits of this event valid for ASIL D receivers.
              allocationMemoryTechnology: sub-sdg=EventInstanceMemoryTechnology  # The memory technology used when allocating memory for the event. Default: SharedMemory.
        ProvidedEventInstanceResourceLimit  # Stores the resource limits of a single event.
          sdg primitive attribute slotsLimit: category=INTEGER, lower-multiplicity=1, upper-multiplicity=1, max=0xFFFFFFFF, min=0x1  # The slot limit (32 bit unsigned integer).
          sdg primitive attribute connectionsLimit: category=INTEGER, lower-multiplicity=1, upper-multiplicity=1, max=0xFFFFFFFF, min=0x1  # The connection limit (32 bit unsigned integer).
        ProvidedServiceInstanceConnectionEndpoint  # Stores the address information of a connection endpoint.
          sdg primitive attribute domain: category=INTEGER, lower-multiplicity=1, upper-multiplicity=1, max=0xFFFFFFFF, min=0x0  # The domain (32 bit unsigned integer).
          sdg primitive attribute port: category=INTEGER, lower-multiplicity=1, upper-multiplicity=1, max=0xFFFFFFFF, min=0x0  # The port (32 bit unsigned integer).
        ZeroCopyBindingServiceInterfaceDeploymentExtension: extends-meta-class=UserDefinedServiceInterfaceDeployment
          attributes:
            sdg aggregation with variation userDefinedZeroCopyBinding: lower-multiplicity=0, upper-multiplicity=1, variation=false, sub-sdg=ZeroCopyBindingServiceInterfaceDeployment
        ZeroCopyBindingServiceInterfaceDeployment  # Stores the zero copy binding data of the UserDefinedServiceInterfaceDeployment.
          sdg primitive attribute serviceInterfaceId: category=INTEGER, lower-multiplicity=1, upper-multiplicity=1, max=0xFFFFFFFF, min=0x0  # The service interface ID (32 bit unsigned integer).
        ZeroCopyBindingEventDeploymentExtension: extends-meta-class=UserDefinedEventDeployment
          attributes:
            sdg aggregation with variation userDefinedZeroCopyBinding: lower-multiplicity=0, upper-multiplicity=1, variation=false, sub-sdg=ZeroCopyBindingEventDeployment
        ZeroCopyBindingEventDeployment: caption=true  # Stores the zero copy binding data of the UserDefinedEventDeployment.
          sdg primitive attribute eventId: category=INTEGER, lower-multiplicity=1, upper-multiplicity=1, max=0xFFFFFFFF, min=0x0  # The event ID (32 bit unsigned integer).
        EventInstanceMemoryTechnology  # The memory technology used for a event.
          sdg primitive attribute memoryTechnology: category=ENUMERATION, lower-multiplicity=1, upper-multiplicity=1  # The memory technology.
        RequiredEventInstance  # Stores the configuration of a single event instance.
          attributes:
            sdg reference event: lower-multiplicity=1, upper-multiplicity=1, dest-sdg=ZeroCopyBindingEventDeployment  # The event this configuration refers to.
            sdg aggregation with variation allocationMemoryTechnology: lower-multiplicity=0, upper-multiplicity=1, variation=false, sub-sdg=EventInstanceMemoryTechnology  # The memory technology used when allocating memory for the event. Default: SharedMemory.
