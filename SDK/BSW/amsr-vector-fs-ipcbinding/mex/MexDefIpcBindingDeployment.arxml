AUTOSAR XML (schema 00049)
package /MICROSAR/ADAPTIVE
  sdg def UserDefinedIpcBindingExtensionModel
    sdg-classes:
      11 x sdg class:
        ProvidedIpcBindingServiceInstanceExtension: extends-meta-class=ProvidedUserDefinedServiceInstance
          attributes:
            sdg aggregation with variation userDefinedIpcBinding: lower-multiplicity=0, upper-multiplicity=1, variation=false, sub-sdg=ProvidedIpcBindingServiceInstance
        ProvidedIpcBindingServiceInstance  # Stores the IpcBinding data of the ProvidedUserDefinedServiceInstance
          5 x sdg primitive attribute, all with upper-multiplicity=1:
            serviceInstanceId: category=INTEGER, lower-multiplicity=1, max=0xFFFFFFFE, min=0  # The service instance ID (32 bit unsigned integer)
            expectedClientIntegrityLevel: category=ENUMERATION, lower-multiplicity=0  # The expected client integrity level (QM, ASIL_A, ASIL_B, ASIL_C or ASIL_D). Default: QM.
            serviceOfferTimeToLive: category=INTEGER, lower-multiplicity=0, max=0xFFFFFFFF, min=0  # The service offer time-to-live in seconds (32 bit unsigned integer) HINT: This parameter is deprecated and not used anymore (AMSR-28887). The parameter can be removed without any replacement.
            domain: category=INTEGER, lower-multiplicity=1, max=0xFFFFFFFF, min=0  # The domain number of the used IPC endpoint (32 bit unsigned integer)
            port: category=INTEGER, lower-multiplicity=1, max=0xFFFFFFFF, min=0  # The port number of the used IPC endpoint (32 bit unsigned integer)
        RequiredIpcBindingServiceInstanceExtension: extends-meta-class=RequiredUserDefinedServiceInstance
          attributes:
            sdg aggregation with variation userDefinedIpcBinding: lower-multiplicity=0, upper-multiplicity=1, variation=false, sub-sdg=RequiredIpcBindingServiceInstance
        RequiredIpcBindingServiceInstance  # Stores the IpcBinding data of the RequiredUserDefinedServiceInstance
          sdg primitive attribute serviceInstanceId: category=STRING, lower-multiplicity=1, upper-multiplicity=1, pattern=[0-9]*|ALL  # The service instance ID (32 bit unsigned integer or 'ALL')
          sdg primitive attribute minorVersion: category=STRING, lower-multiplicity=1, upper-multiplicity=1, pattern=[0-9]*|ANY  # The required minor version (32 bit unsigned integer or 'ANY'). The required major version is defined by IpcBindingServiceInterfaceDeployment.serviceInterfaceVersion.majorVersion. The specified IpcBindingServiceInterfaceDeployment.serviceInterfaceVersion.minorVersion is irrelevant for the required service instance search.
          sdg primitive attribute expectedServerIntegrityLevel: category=ENUMERATION, lower-multiplicity=0, upper-multiplicity=1  # The expected server integrity level (QM, ASIL_A, ASIL_B, ASIL_C or ASIL_D). Default: QM.
        Version
          sdg primitive attribute major: category=INTEGER, lower-multiplicity=1, upper-multiplicity=1, max=0xFFFFFFFF, min=0  # The major version (32 bit unsigned integer)
          sdg primitive attribute minor: category=INTEGER, lower-multiplicity=1, upper-multiplicity=1, max=0xFFFFFFFE, min=0  # The minor version (32 bit unsigned integer) of all offered service instances. This minor version is only relevant for skeleton-side service offers.
        IpcBindingServiceInterfaceDeploymentExtension: extends-meta-class=UserDefinedServiceInterfaceDeployment
          attributes:
            sdg aggregation with variation userDefinedIpcBinding: lower-multiplicity=0, upper-multiplicity=1, variation=false, sub-sdg=IpcBindingServiceInterfaceDeployment
        IpcBindingServiceInterfaceDeployment  # Stores the IpcBinding data of the UserDefinedServiceInterfaceDeployment
          attributes:
            sdg primitive attribute serviceInterfaceId: category=INTEGER, lower-multiplicity=1, upper-multiplicity=1, max=0xFFFFFFFF, min=0  # The service interface ID (32 bit unsigned integer)
            sdg aggregation with variation serviceInterfaceVersion: lower-multiplicity=1, upper-multiplicity=1, variation=false, sub-sdg=Version
        IpcBindingEventDeploymentExtension: extends-meta-class=UserDefinedEventDeployment
          attributes:
            sdg aggregation with variation userDefinedIpcBinding: lower-multiplicity=0, upper-multiplicity=1, variation=false, sub-sdg=IpcBindingEventDeployment
        IpcBindingEventDeployment  # Stores the IpcBinding data of the UserDefinedEventDeployment
          sdg primitive attribute eventId: category=INTEGER, lower-multiplicity=1, upper-multiplicity=1, max=0xFFFFFFFF, min=0  # The event ID (32 bit unsigned integer)
        IpcBindingMethodDeploymentExtension: extends-meta-class=UserDefinedMethodDeployment
          attributes:
            sdg aggregation with variation userDefinedIpcBinding: lower-multiplicity=0, upper-multiplicity=1, variation=false, sub-sdg=IpcBindingMethodDeployment
        IpcBindingMethodDeployment  # Stores the IpcBinding data of the UserDefinedMethodDeployment
          sdg primitive attribute methodId: category=INTEGER, lower-multiplicity=1, upper-multiplicity=1, max=0xFFFFFFFF, min=0  # The method ID (32 bit unsigned integer)
