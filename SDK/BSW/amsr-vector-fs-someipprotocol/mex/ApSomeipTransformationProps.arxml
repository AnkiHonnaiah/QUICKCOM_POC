AUTOSAR XML (schema 00049)
package /MICROSAR/ADAPTIVE
  sdg def ApSomeipTransformationPropsExtension
    sdg-classes:
      sdg class ApSomeipTransformationPropsExtended: gid=DvMex:ApSomeipTransformationPropsExtended, extends-meta-class=ApSomeipTransformationProps
        sdg primitive attribute staticArrayHasLengthField: category=BOOLEAN, lower-multiplicity=0, upper-multiplicity=1  # Inconditionally disables the length field for static (fixed-size) arrays.
