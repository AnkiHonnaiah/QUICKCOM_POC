AUTOSAR XML (schema 00049)
package /MICROSAR/ADAPTIVE
  sdg def ExternalIpcExtensionModel
    sdg-classes:
      sdg class ExternalIpcApiUsage: extends-meta-class=Executable  # Usage of this extension model shall denote usage of ExternalIpc in a MICROSAR Adaptive application.
        sdg primitive attribute useExternalIpcApi: category=BOOLEAN, lower-multiplicity=0, upper-multiplicity=1  # This attribute indicates usage of ExternalIpc component.
