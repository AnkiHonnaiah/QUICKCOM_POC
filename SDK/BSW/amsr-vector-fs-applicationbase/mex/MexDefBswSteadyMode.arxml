AUTOSAR XML (schema 00049)
package /MICROSAR/ADAPTIVE
  sdg def BswSteadyModeExtensionModel
    sdg-classes:
      sdg class BswSteadyMode: extends-meta-class=Process  # Usage of this extension model shall denote usage of Steady Mode in a MICROSAR Adaptive application.
        sdg primitive attribute steadyMode: category=BOOLEAN, lower-multiplicity=0, upper-multiplicity=1  # This attribute indicates Steady Mode shall be used for all steady-enabled API.
