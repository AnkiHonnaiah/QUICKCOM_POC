AUTOSAR XML (schema 00049)
package /MICROSAR/ADAPTIVE
  sdg def BswExecutableTypeExtensionModel
    sdg-classes:
      sdg class BswExecutable: extends-meta-class=Executable  # This model extension can be used to identify a relation between an executable and a certain type when other methods of identification are not sufficient.
        sdg primitive attribute bswExecutableType: category=ENUMERATION, lower-multiplicity=0, upper-multiplicity=1  # This attribute indicates that an Executable is of a certain type
