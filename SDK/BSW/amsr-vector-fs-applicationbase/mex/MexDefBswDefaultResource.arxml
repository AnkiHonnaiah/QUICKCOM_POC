AUTOSAR XML (schema 00049)
package /MICROSAR/ADAPTIVE
  sdg def BswDefaultResourceExtensionModel
    sdg-classes:
      sdg class BswDefaultResource: extends-meta-class=Process  # Allows for configuration of the default resource.
        attributes:
          sdg aggregation with variation defaultResourceConfig: lower-multiplicity=0, upper-multiplicity=1, sub-sdg=DefaultResourceConfig  # Aggregation of a DefaultResourceConfig SdgClass.
      sdg class DefaultResourceConfig
        sdg primitive attribute size: category=INTEGER, lower-multiplicity=1, upper-multiplicity=1, min=1  # This attribute indicates the configured size in bytes for the default resource.
        sdg primitive attribute expanding: category=BOOLEAN, lower-multiplicity=1, upper-multiplicity=1  # This attribute indicates if the default resource can grow when its size exceeds the configured size.
