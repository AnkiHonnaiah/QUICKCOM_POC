AUTOSAR XML (schema 00049)
package /MICROSAR/ADAPTIVE
  sdg def BswVersionedApiExtensionModel
    sdg-classes:
      sdg class BswVersionedApi: extends-meta-class=Executable  # Usage of this extension model shall denote which respective version of ara::core and ara::com is used by a MICROSAR Adaptive application.
        sdg primitive attribute amsrAraCoreApi: category=ENUMERATION, lower-multiplicity=0, upper-multiplicity=1  # Specifies the ara::core API version.
        sdg primitive attribute amsrAraComApi: category=ENUMERATION, lower-multiplicity=0, upper-multiplicity=1  # Specifies the ara::com API version.
