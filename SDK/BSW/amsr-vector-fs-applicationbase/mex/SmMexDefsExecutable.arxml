AUTOSAR XML (schema 00049)
package /MICROSAR/ADAPTIVE
  sdg def SmExtensionModel
    sdg-classes:
      sdg class SmExecutableExtension: extends-meta-class=Executable
        sdg primitive attribute useSmApi: category=BOOLEAN, lower-multiplicity=0, upper-multiplicity=1  # This attribute indicates usage of the StateManager component
