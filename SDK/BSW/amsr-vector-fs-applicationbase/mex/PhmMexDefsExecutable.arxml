AUTOSAR XML (schema 00049)
package /MICROSAR/ADAPTIVE
  sdg def PhmExtensionModel
    sdg-classes:
      sdg class PhmExecutableExtension: extends-meta-class=Executable  # Denotes usage of PlatformHealthManager in a MICROSAR Adaptive application.
        sdg primitive attribute usePhmApi: category=BOOLEAN, lower-multiplicity=0, upper-multiplicity=1  # This attribute indicates usage of the PlatformHealthManager component
