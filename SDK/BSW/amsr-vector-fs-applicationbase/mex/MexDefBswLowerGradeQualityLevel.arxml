AUTOSAR XML (schema 00049)
package /MICROSAR/ADAPTIVE
  sdg def BswLowerGradeQualityLevelExtensionModel
    sdg-classes:
      sdg class BswLowerGradeQualityLevel: extends-meta-class=Executable  # This extension model is used to activate source code with lower quality level than originally defined in the component.
        sdg primitive attribute lowerGradeQualityLevel: category=ENUMERATION, lower-multiplicity=0, upper-multiplicity=1  # Activates lower grade quality code equal to the selected quality level
