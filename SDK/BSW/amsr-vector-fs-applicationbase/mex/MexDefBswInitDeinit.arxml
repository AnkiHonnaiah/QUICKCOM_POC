AUTOSAR XML (schema 00049)
package /MICROSAR/ADAPTIVE
  sdg def BswInitDeinitExtensionModel
    sdg-classes:
      sdg class BswInitDeinitExecutableExtension: extends-meta-class=Executable  # This model extension provides the possibility to identify component usage by defining a set of attributes to be used when wrapping component specific Initialize and Deinitialize APIs. Usage of the model extension to specify component usage in an application will require no additional changes to ApplicationBase generator source code. For additional information refer to ApplicationBase TechRef.
        attributes:
          sdg aggregation with variation bswInitDeinitAttributesWrapper: lower-multiplicity=0, upper-multiplicity-infinite=true, sub-sdg=BswInitDeinitAttributes  # Wrapper for BswInitDeinitAttributes.
      sdg class BswInitDeinitAttributes
        4 x sdg primitive attribute, all with lower-multiplicity=1, upper-multiplicity=1:
          bswInitDeinitComponentName: category=STRING  # The name of the component this extension is attached to.
          bswInitDeinitIncludePath: category=STRING  # Identifies the path to which file contains given components Initialize() and Deinitialize()
          bswInitDeinitNamespace: category=STRING  # Identifies the namespace where the Initialize() and Deinitialize() resides in for the component. Can only contain alphanumerical characters and underscores.
          bswInitDeinitPriority: category=INTEGER  # Denotes in which order the component should be initialized and deinitialized to compared to other components. Custom components shall use a value greater than 100 since the range 1-100 is reserved for core components.
