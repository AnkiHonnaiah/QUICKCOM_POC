AUTOSAR XML (schema 00049)
package /MICROSAR/ADAPTIVE
  sdg def LogConfigExtensionModel
    sdg-classes:
      sdg class LogConfigApiUsage: extends-meta-class=Executable  # Usage of this extension model shall denote usage of LogConfig in a MICROSAR Adaptive application.
        sdg primitive attribute useLogConfigApi: category=BOOLEAN, lower-multiplicity=0, upper-multiplicity=1  # This attribute indicates usage of the LogConfig component.
