AUTOSAR XML (schema 00049)
package /MICROSAR/ADAPTIVE
  sdg def CryptoExtensionModel
    sdg-classes:
      sdg class CryptoExecutableExtension: extends-meta-class=Executable  # Denotes usage of the Crypto component in a MICROSAR Adaptive application.
        sdg primitive attribute useCryptoApi: category=BOOLEAN, lower-multiplicity=0, upper-multiplicity=1  # This attribute indicates usage of the Crypto component. Not to be used when CryptoInterface is defined in the model (see TechRef for ApplicationBase).
