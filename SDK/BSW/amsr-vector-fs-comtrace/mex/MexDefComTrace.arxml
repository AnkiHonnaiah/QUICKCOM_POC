AUTOSAR XML (schema 00049)
package /MICROSAR/ADAPTIVE
  sdg def ComTraceModelExtension
    sdg-classes:
      6 x sdg class:
        ComTraceClientServerOperationModelExtension: extends-meta-class=ClientServerOperation  # ComTrace specific model extension for ClientServerOperation (Method).
          attributes:
            sdg aggregation with variation traceConfig: lower-multiplicity=0, upper-multiplicity=1, variation=false, sub-sdg=TraceMethodConfig
        ComTraceVariableDataPrototypeModelExtension: extends-meta-class=VariableDataPrototype  # ComTrace specific model extension for VariableDataPrototype (Event).
          attributes:
            sdg aggregation with variation traceConfig: lower-multiplicity=0, upper-multiplicity=1, variation=false, sub-sdg=TraceEventConfig
        ComTraceFieldModelExtension: extends-meta-class=Field  # ComTrace specific model extension for Field.
          attributes:
            sdg aggregation with variation traceConfigGetter: lower-multiplicity=0, upper-multiplicity=1, variation=false, sub-sdg=TraceMethodConfig  # Trace configuration for the field getter method.
            sdg aggregation with variation traceConfigSetter: lower-multiplicity=0, upper-multiplicity=1, variation=false, sub-sdg=TraceMethodConfig  # Trace configuration for the field setter method.
            sdg aggregation with variation traceConfigNotifier: lower-multiplicity=0, upper-multiplicity=1, variation=false, sub-sdg=TraceFieldNotifierConfig  # Trace configuration for the field notifier event.
        TraceMethodConfig
          4 x sdg primitive attribute, all with category=BOOLEAN, lower-multiplicity=0, upper-multiplicity=1:
            traceRequestSend  # Enable / Disable tracing of transmitted ara::com method requests. Default: disabled.
            traceRequestReceived  # Enable / Disable tracing of received ara::com method requests. Default: disabled.
            traceResponseSend  # Enable / Disable tracing of transmitted ara::com method responses. Default: disabled.
            traceResponseReceived  # Enable / Disable tracing of received ara::com method responses. Default: disabled.
        TraceEventConfig
          sdg primitive attribute traceSend: category=BOOLEAN, lower-multiplicity=0, upper-multiplicity=1  # Enable / Disable tracing of transmitted ara::com events using the Skeleton::Event::Send(SampleType) API. Default: disabled.
          sdg primitive attribute traceSendAllocate: category=BOOLEAN, lower-multiplicity=0, upper-multiplicity=1  # Enable / Disable tracing of transmitted ara::com events using the Skeleton::Event::Send(SampleAllocateePtr) API. Default: disabled.
          sdg primitive attribute traceReadSample: category=BOOLEAN, lower-multiplicity=0, upper-multiplicity=1  # Enable / Disable tracing of read ara::com event samples. Default: disabled. With AUTOSAR version R18-03: Trace emplacement of single event sample into the SampleContainer in context of GetCachedSamples() API. Since AUTOSAR version R19-03: Trace execution of the user provided callable f given to the GetNewSamples() API.
        TraceFieldNotifierConfig
          sdg primitive attribute traceSend: category=BOOLEAN, lower-multiplicity=0, upper-multiplicity=1  # Enable / Disable tracing of transmitted ara::com field notifier events using the Skeleton::Field::Update(FieldType) API. Default: disabled.
          sdg primitive attribute traceReadSample: category=BOOLEAN, lower-multiplicity=0, upper-multiplicity=1  # Enable / Disable tracing of read ara::com field notifier samples. Default: disabled. With AUTOSAR version R18-03: Trace emplacement of single event sample into the SampleContainer in context of GetCachedSamples() API. Since AUTOSAR version R19-03: Trace execution of the user provided callable f given to the GetNewSamples() API.
