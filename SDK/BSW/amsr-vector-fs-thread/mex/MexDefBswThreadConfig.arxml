AUTOSAR XML (schema 00049)
package /MICROSAR/ADAPTIVE
  sdg def BswThreadConfigExtensionModel
    sdg-classes:
      sdg class BswThreadConfigurations: extends-meta-class=Process
        attributes:
          sdg aggregation with variation bswThreadConfigurations: lower-multiplicity=0, upper-multiplicity-infinite=true, variation=false, sub-sdg=BswThreadConfiguration  # This model extension allows the user to configure settings of threads created by AMSR processes and libraries. Refer to the functional clusters TechRef to know which thread configurations are exposed to the user: not documented configurations will not be taken into account.
      sdg class BswThreadConfiguration: caption=true  # Caption acts as an identifier which uniquely identifies the BswThreadConfiguration. Valid identifiers are documented in the related functional cluster TechRef. Not documented identifiers are ignored.
        attributes:
          sdg aggregation with variation bswThreadSchedulingConfiguration: lower-multiplicity=0, upper-multiplicity=1, sub-sdg=BswThreadSchedulingConfiguration  # Optional scheduling settings of a BswThreadConfiguration. If not specified, scheduling settings will be inherited from the parent thread.
          sdg primitive attribute stackSize: category=INTEGER, lower-multiplicity=0, upper-multiplicity=1  # Optional parameter to configure the stack size of the thread in bytes.
      sdg class BswThreadSchedulingConfiguration
        sdg primitive attribute schedulingPolicy: category=ENUMERATION, lower-multiplicity=1, upper-multiplicity=1  # Mandatory scheduling policy of the BswThreadSchedulingConfiguration. SCHED_OTHER behavior is OS specific.
        sdg primitive attribute schedulingPriority: category=INTEGER, lower-multiplicity=1, upper-multiplicity=1  # Mandatory scheduling priority of the BswThreadSchedulingConfiguration. Values are OS specific.
        sdg primitive attribute niceValue: category=INTEGER, lower-multiplicity=0, upper-multiplicity=1  # Optional nice value of thread. Functionality is only supported on Linux and valid when schedulingPolicy is SCHED_OTHER and schedulingPriority is 0
