AUTOSAR XML (schema 00049)
package /MICROSAR/ADAPTIVE
  sdg def SocalModelExtension
    sdg-classes:
      4 x sdg class:
        SocalProcessModelExtension: extends-meta-class=Process
          attributes:
            sdg aggregation with variation araComThreadPool: lower-multiplicity=0, upper-multiplicity-infinite=true, sub-sdg=ThreadPool  # User-defined thread pools container.
            sdg aggregation with variation pPortDefaultThreadPool: lower-multiplicity=0, upper-multiplicity=1, sub-sdg=DefaultThreadPool  # Shared default thread pool for ara::com skeletons of the process.
            sdg aggregation with variation rPortDefaultThreadPool: lower-multiplicity=0, upper-multiplicity=1, sub-sdg=DefaultThreadPool  # Shared default thread pool for ara::com proxies of the process.
        ThreadPool  # Definition of a user-defined thread pool to handle incoming method requests.
          attributes:
            sdg primitive attribute numberOfThreads: category=INTEGER, lower-multiplicity=1, upper-multiplicity=1, max=4294967295, min=1  # Number of worker threads in the pool.
            sdg primitive attribute maxNumberOfTasks: category=INTEGER, lower-multiplicity=1, upper-multiplicity=1, max=4294967295, min=1  # Maximum queue size for incoming tasks.
            sdg aggregation with variation assignedPPortPrototype: lower-multiplicity=1, upper-multiplicity-infinite=true, sub-sdg=PPortThreadPoolAssignment  # All PPortPrototypes that shall be handled within this thread pool.
            sdg reference bswThreadConfigurationRef: lower-multiplicity=0, upper-multiplicity=1, dest-sdg=BswThreadConfiguration  # Reference to the thread configuration the user-defined thread pool thread(s) shall be created for.
        DefaultThreadPool  # Definition of a default thread pool for ara::com proxies or skeletons.
          attributes:
            sdg primitive attribute maxNumberOfTasks: category=INTEGER, lower-multiplicity=0, upper-multiplicity=1, max=4294967295, min=1  # Maximum queue size for incoming tasks.
            sdg reference bswThreadConfigurationRef: lower-multiplicity=0, upper-multiplicity=1, dest-sdg=BswThreadConfiguration  # Reference to the thread configuration the default thread pool (rPortDefaultThreadPool or pPortDefaultThreadPool) thread shall be created for.
        PPortThreadPoolAssignment  # Deﬁnition of a PPortPrototype-to-ThreadPool assignment.
          attributes:
            sdg foreign reference pPortPrototype: lower-multiplicity=1, upper-multiplicity=1, dest-meta-class=PPortPrototype  # Stores a reference to a PPortPrototype.
