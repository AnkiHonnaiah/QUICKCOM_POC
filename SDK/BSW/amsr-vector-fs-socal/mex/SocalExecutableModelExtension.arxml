AUTOSAR XML (schema 00049)
package /MICROSAR/ADAPTIVE
  sdg def SocalModelExtension
    sdg-classes:
      sdg class SocalExecutableModelExtension: extends-meta-class=Executable
        attributes:
          sdg primitive attribute araComRuntimeProcessingMode: category=ENUMERATION, lower-multiplicity=0, upper-multiplicity=1  # The processing mode defines if reactor events are handled in a thread driven manner or polling based. Further, the selected mode influences the set of available APIs. If not set, it defaults to ThreadDriven mode.
          sdg foreign reference genericProxyServiceInterfaceRef: lower-multiplicity=0, upper-multiplicity-infinite=true, dest-meta-class=ServiceInterface  # List of service interface references that are used with generic proxy.
