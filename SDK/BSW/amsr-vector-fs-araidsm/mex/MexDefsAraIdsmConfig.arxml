AUTOSAR XML (schema 00049)
package /MICROSAR/ADAPTIVE
  sdg def AraIdsmConfigModelExtension
    sdg-classes:
      sdg class AraIdsmExecutableExtensions: extends-meta-class=Executable, caption=false
        attributes:
          sdg aggregation with variation araIdsmConfig: lower-multiplicity=0, upper-multiplicity=1, variation=false, sub-sdg=AraIdsmConfig
      sdg class AraIdsmConfig: caption=false
        sdg primitive attribute numberOfParallelRequestExecutions: category=INTEGER, lower-multiplicity=0, upper-multiplicity=1  # The number of requests that can be handled in parallel. If not configured, the default value is 1
        sdg primitive attribute requestQueueSize: category=INTEGER, lower-multiplicity=0, upper-multiplicity=1  # The size of the queue for incoming requests and notifications from the DM.
