AUTOSAR XML (schema 00049)
package /MICROSAR/ADAPTIVE
  sdg def SwcServiceDependencyConfigModelExtensions
    sdg-classes:
      sdg class SwcServiceDependencyExtensions: extends-meta-class=SwcServiceDependency
        attributes:
          sdg reference idsmPPortRef: lower-multiplicity=0, upper-multiplicity=1, dest-sdg=IdsmPPort
          sdg reference idsmRPortRef: lower-multiplicity=0, upper-multiplicity=1, dest-sdg=IdsmRPort
