AUTOSAR XML (schema 00049)
package /MICROSAR/ADAPTIVE
  sdg def AraIdsmConfigModelExtension
    sdg-classes:
      sdg class AraIdsmAdaptiveApplicationSwComponentTypeExtension: extends-meta-class=AdaptiveApplicationSwComponentType, caption=false
        attributes:
          sdg aggregation with variation idsmRPort: lower-multiplicity=0, upper-multiplicity-infinite=true, variation=false, sub-sdg=IdsmRPort
          sdg aggregation with variation idsmPPort: lower-multiplicity=0, upper-multiplicity-infinite=true, variation=false, sub-sdg=IdsmPPort
      sdg class IdsmRPort: caption=true
        sdg primitive attribute interfaceType: category=ENUMERATION, lower-multiplicity=1, upper-multiplicity=1  # The required port interface type.
      sdg class IdsmPPort: caption=true
        sdg primitive attribute interfaceType: category=ENUMERATION, lower-multiplicity=1, upper-multiplicity=1  # The provided port interface type.
