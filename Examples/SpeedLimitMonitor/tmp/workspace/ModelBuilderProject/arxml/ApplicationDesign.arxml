AUTOSAR XML (schema 00049)
package /AppDesign
  adaptive application sw component type AASwCompType_App_ModelBuilderApplication_SpeedMonitorExecutable
    provide port SpeedLimitMonitor_Provide: provided-interface=SpeedLimitService
  executable SpeedMonitorExecutable: category=APPLICATION_LEVEL, version=1.0.0
    root sw component prototype RootSwcPrototype: application-type=AASwCompType_App_ModelBuilderApplication_SpeedMonitorExecutable
  process design PrcDesign_App_ModelBuilderApplication_SpeedMonitorExecutable: executable=SpeedMonitorExecutable
  adaptive application sw component type AASwCompType_App_ModelBuilderApplication_WarningDisplayExecutable
    require port SpeedLimitMonitor_Require: required-interface=SpeedLimitService
  executable WarningDisplayExecutable: category=APPLICATION_LEVEL, version=1.0.0
    root sw component prototype RootSwcPrototype: application-type=AASwCompType_App_ModelBuilderApplication_WarningDisplayExecutable
  process design PrcDesign_App_ModelBuilderApplication_WarningDisplayExecutable: executable=WarningDisplayExecutable
  software cluster design SwClDesign_App_ModelBuilderApplication: contained-process=[PrcDesign_App_ModelBuilderApplication_SpeedMonitorExecutable, PrcDesign_App_ModelBuilderApplication_WarningDisplayExecutable]
