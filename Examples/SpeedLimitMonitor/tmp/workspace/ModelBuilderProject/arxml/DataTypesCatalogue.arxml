AUTOSAR XML (schema 00049)
package /Datatypes
  std cpp implementation data type OverLimitEnum: compu {0=NOT_OVER, 1=OVER_LOW, 2=OVER_HIGH}, type-emitter=TYPE_EMITTER_ARA, type-reference=uint8_t
    namespaces:
      symbol props ns0: symbol=datatypes
