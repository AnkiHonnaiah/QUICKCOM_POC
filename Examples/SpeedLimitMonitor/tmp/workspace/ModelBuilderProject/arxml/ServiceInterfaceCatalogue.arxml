AUTOSAR XML (schema 00049)
package /ServiceInterfaces/PkgSpeedLimitService/Latest
  service interface SpeedLimitService
    namespaces:
      symbol props ns0: symbol=services
      symbol props ns1: symbol=speedlimitservice
    events:
      data SpeedOverLimitEvent: type=OverLimitEnum
package /ServiceInterfaces/PkgSpeedLimitService/Latest/PkgDeployment
  user defined service interface deployment IpcSvcIfDeploy_SpeedLimitService: service-interface=SpeedLimitService
    user defined event deployment IpcEventDeploy_SpeedOverLimitEvent: event=SpeedOverLimitEvent
